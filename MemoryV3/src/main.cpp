#include "Arduino.h"

#include <Wire.h>
#include <SeeedOLED.h>
#include <avr/pgmspace.h>


// Logo de l'os en bitmap
static const unsigned char SeeedLogo[] PROGMEM = {

  0xff, 0xff, 0xff, 0xff, 0xff, 0xff, 0xff, 0xff, 0xff, 0xff, 0xff, 0xff, 0xff, 0xff, 0xff, 0xff,
  0xff, 0xff, 0xff, 0xff, 0xff, 0xff, 0xff, 0xff, 0xff, 0xff, 0xff, 0xff, 0xff, 0xff, 0xff, 0xff,
  0xff, 0xff, 0xff, 0xff, 0xff, 0xff, 0xff, 0xff, 0xff, 0xff, 0xff, 0xff, 0xff, 0xff, 0xff, 0xff,
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  0xff, 0xff, 0xff, 0xff, 0xff, 0xff, 0xff, 0xff, 0xff, 0xff, 0xff, 0xff, 0xff, 0xff, 0xff, 0xff

};

boolean button1WasUp = false; // Permet d'éviter de rentrer dans la condition "button1WasUp && ..."
int MoPin = 8;
boolean stopDisplay = false; // Permet de gérer l'état de l'affichage
boolean isReminding = false;
unsigned long lastPush = 0;
unsigned long nextReminderIn = 0;
unsigned long timeBeforeStop = 5000;
unsigned long reminderTime = 10000;

void setup() {
  Wire.begin();
  Serial.begin(9600);

  // Initialise l'écran OLED
  SeeedOled.init();
  SeeedOled.clearDisplay();
  SeeedOled.setNormalDisplay();
  SeeedOled.setPageMode();

  pinMode(13, INPUT_PULLUP); // Configurer le bouton avec pull-up interne
}

void loop()
{

  boolean button1IsUp = digitalRead(13);

  // Si le bouton est pressé et que l'état du stop display est à true => alors on change l'état du stop display pour false
  if (button1WasUp && !button1IsUp) {
    lastPush = millis();
    if (!stopDisplay)
    {
      stopDisplay = !stopDisplay; // Efface l'affichage
      isReminding = false; // Remet le rappel à false (s'il état vrai)
      nextReminderIn = 0; // Reset le temps du prochain rappel (puisqu'il n'y en aura plus)
    }
  }

  if (millis() - lastPush > timeBeforeStop && !stopDisplay && isReminding == false) { // Verifie si l'état de l'écran est à true et si 5s sont passées depuis le début
    stopDisplay = !stopDisplay; // Efface ce qui est à l'écran
    nextReminderIn = millis() + reminderTime; // Met à jour le temps pour le prochain rappel
    isReminding = true; // Indique qu'un rappel est en attente
  }

  if (nextReminderIn > 0 && millis() > nextReminderIn && isReminding == true){ // Si notre prochain rappel est à plus de 0 secondes, que le temps actuel le dépasse et qu'il y a un rappel
    stopDisplay = false; // On réaffiche les éléments à l'écran

    isReminding = false; // Désactive le rappel pour éviter de l'appeller en boucle
    lastPush = millis(); // Reset le compteur d'inactivité
    nextReminderIn =0;   // Reset le temps pour le prochain rappel
  }

  button1WasUp = button1IsUp;

  if (stopDisplay){
    SeeedOled.clearDisplay(); // Efface l'affichage
    digitalWrite(MoPin, LOW); // Arrete les vibrations
  }else{
    SeeedOled.drawBitmap((unsigned char *)SeeedLogo, 1024); // Affiche le logo
    
    // Gestion des vibrations (boucle qui : vibre pendant 100 ms et s'arrête pour 1ms)
    digitalWrite(MoPin, HIGH);
    delay(100);

    digitalWrite(MoPin, LOW);
    delay(1);
  }
  
}